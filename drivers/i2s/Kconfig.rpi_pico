## drivers/i2s/Kconfig.rpi_pico
```kconfig
# STM32 I2S driver configuration options

# Copyright (c) 2018 STMicroelectronics
# SPDX-License-Identifier: Apache-2.0

config I2S_RPI_PICO_PIO
	bool "Raspberry Pi Pico PIO I2S controller driver"
	default y
	# depends on DT_HAS_RASPBERRYPI_PICO_SPI_PIO_ENABLED # TODO: do this for device tree I2S
	select PICOSDK_USE_PIO
	select PICOSDK_USE_CLAIM
	select PINCTRL
	help
	  Enable driving I2S via PIO on the Raspberry Pi Pico


if I2S_RPI_PICO_PIO

config I2S_RPI_PICO_PIO_RX_QUEUE_SIZE
	int "RX queue length"
	default 32
	help
	  This option sets the number of elements allocated for the rx software
	  queue. This should match the number of blocks in the memory slab
	  that will hold the i2s receive data.

config I2S_RPI_PICO_PIO_TX_QUEUE_SIZE
	int "TX queue length"
	default 32
	help
	  This option sets the number of elements allocated for the tx software
	  queue. This should match the number of blocks in the memory slab
	  that will hold the i2s transmit data.

endif # I2S_RPI_PICO_PIO
```

## dts/bindings/i2s/raspberrypi,pico-i2s-pio.yaml
```yaml
# Copyright (c) 2026 Robin Sachsenweger Ballantyne <makenenjoy@gmail.com>
# SPDX-License-Identifier: Apache-2.0

description: Raspberry Pi Pico PIO I2S

compatible: "raspberrypi,pico-i2s-pio"

include: [i2s-controller.yaml, "raspberrypi,pico-pio-device.yaml"]
# TODO: Finish documenting driver here.
properties:
  pinctrl-0:
    required: true
    description: |
      Must name a node containing the groups `clks`, `ws` and one or both of `tx_data` and/or
      `rx_data`.

  pinctrl-names:
    required: true

  dmas:
    required: true
    description: |
      TX and/or RX DMA channel specifiers. At least one is required.

      Note: the DREQ slot cell is ignored. raspberrypi,pico-dma.yaml fixes
      #dma-cells at 3, but the driver derives the slot from pio_get_dreq() once
      the state machine has been allocated, which is not known until
      i2s_configure() runs. Write 0 as the placeholder. A named
      RPI_PICO_DMA_SLOT_* constant is not wrong, but it is misleading, since it
      is only ever correct when the dynamically allocated state machine happens
      to be the one the constant names.
# TODO: Write example above

  dma-names:
    required: true
    description: |
      `tx`, `rx`, or both.
```
